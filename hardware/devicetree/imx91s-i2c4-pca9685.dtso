/dts-v1/;
/plugin/;

/*
 * GarServoPet expansion-header I2C bus.
 *
 * FRDM-IMX91S 40-pin header:
 *   pin 3: GPIO_IO02 / LPI2C4_SDA
 *   pin 5: GPIO_IO03 / LPI2C4_SCL
 *
 * The numeric pin tuples are the values of:
 *   MX91_PAD_GPIO_IO02__LPI2C4_SDA
 *   MX91_PAD_GPIO_IO03__LPI2C4_SCL
 * from imx91-pinfunc.h.  Numeric values keep this overlay compilable without
 * requiring a complete Linux kernel source checkout.
 */

/{
	fragment@0 {
		target-path = "/soc@0/bus@44000000/pinctrl@443c0000";

		__overlay__ {
			gar_servo_pet_lpi2c4_pins: lpi2c4-gar-servo-pet-grp {
				fsl,pins = <
					0x0018 0x01c8 0x03fc 0x01 0x00 0x40000b9e
					0x001c 0x01cc 0x03f8 0x01 0x00 0x40000b9e
				>;
			};
		};
	};

	fragment@1 {
		target-path = "/soc@0/bus@42000000/i2c@42540000";

		__overlay__ {
			clock-frequency = <100000>;
			pinctrl-names = "default";
			pinctrl-0 = <&gar_servo_pet_lpi2c4_pins>;
			status = "okay";
		};
	};
};
